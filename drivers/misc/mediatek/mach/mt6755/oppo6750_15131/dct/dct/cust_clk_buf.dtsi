/*
 * Generated by MTK SP Drv_CodeGen Version 03.13.6  for MT6755. Copyright MediaTek Inc. (C) 2013.
 * Thu Jul 30 11:48:34 2026
 * Do Not Modify the File.
 */

&rf_clock_buffer_ctrl {
	compatible = "mediatek, rf_clock_buffer";
	buffer1 = <2>;
	buffer2 = <0>;
	buffer3 = <1>;
	buffer4 = <1>;
};
&pmic_clock_buffer_ctrl {
	compatible = "mediatek, pmic_clock_buffer";
	buffer1 = <2>;
	buffer2 = <1>;
	buffer3 = <1>;
	buffer4 = <2>;
};
